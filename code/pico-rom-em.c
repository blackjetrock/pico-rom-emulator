////////////////////////////////////////////////////////////////////////////////
//
// Pico ROM Emulator
//
////////////////////////////////////////////////////////////////////////////////


#include <ctype.h>
#include <stdio.h>
#include <string.h>
#include <stdlib.h>
#include "pico/stdlib.h"
//#include "hardware/i2c.h"
#include "hardware/pio.h"
#include "hardware/clocks.h"
#include "pico/multicore.h"
#include "pico/bootrom.h"

#if 0
#include "f_util.h"

#include "ff.h"
#include "ff_stdio.h"
#include "hw_config.h"
#include "my_debug.h"


#include "rtc.h"
#endif
#if 0
#include "sd_card.h"
#endif

typedef uint8_t BYTE;

// Use this if breakpoints don't work
#define DEBUG_STOP {volatile int x = 1; while(x) {} }

////////////////////////////////////////////////////////////////////////////////

void prompt(void);
void serial_help(void);

////////////////////////////////////////////////////////////////////////////////
//
// Tracing of processor accesses
//

#define TRACE_ON 0

// How many trace entries are displayed in a column
#define TRACE_B   32

// How many addresses are traced
#define TRACE_N   TRACE_B*4

volatile int trace_i = 0;
volatile int trace_running = 0;

volatile uint16_t trace_addr[TRACE_N];
volatile uint8_t trace_value[TRACE_N];
volatile char trace_type[TRACE_N];

////////////////////////////////////////////////////////////////////////////////


int parameter = 0;
int keypress = 0;

#define TEXT_PARAMETER_LEN 40
char text_parameter[TEXT_PARAMETER_LEN+1] = "";

//-----------------------------------------------------------------------------
//
// ROM Emulator Flags

// OE pin used to switch data direction
// If 0 then DDIR_A15 used, under processor conrol

#define USE_OE_FOR_DATA_DIRECTION 1

// The address lines we are looking at

// Do we run emulation on second core?
#define EMULATE_ON_CORE1   1

#define ROM_SIZE  2*1024
#define ADDRESS_MASK (ROM_SIZE - 1)


// Map from memory space to ROM address space
#define MAP_ROM(X) (X & ADDRESS_MASK)

volatile uint8_t rom_data[ROM_SIZE] =
  {
   // ASSEMBLER_EMBEDDED_CODE_START
0x4c,0x51,0xf9,0x4c,0xb2,0xf9,0x4c,0x9b,0xf9,0x4c,0x7d,0xfe,0xa9,0x0d,0x4c,0x79,
0xfe,0x4c,0xe9,0xfa,0x4c,0x0c,0xfb,0x4c,0x28,0xff,0x4c,0x0b,0xff,0x4c,0xfa,0xfd,
0xa2,0xff,0x9a,0x4c,0x37,0xfc,0x4c,0x16,0xfb,0x4c,0x23,0xfb,0x4c,0xdd,0xfe,0xf8,
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0x55,0x47,0x0d,0x00,0xff,0xff,0xff,0x4c,0x89,0xfc,0x07,0x00,0x00,0xfc,0x04,0x00,

// ASSEMBLER_EMBEDDED_CODE_END
  };

//------------------------------------------------------------------------------

const int D0_PIN = 0;
const int D1_PIN = 1;
const int D2_PIN = 2;
const int D3_PIN = 3;
const int D4_PIN = 4;
const int D5_PIN = 5;
const int D6_PIN = 6;
const int D7_PIN = 7;

//
// The address lines (always inputs)
//
const int  A0_PIN  =  8;
const int  A1_PIN  =  9;
const int  A2_PIN  = 10;
const int  A3_PIN  = 11;
const int  A4_PIN  = 12;
const int  A5_PIN  = 13;
const int  A6_PIN  = 14;
const int  A7_PIN  = 15;
const int  A8_PIN  = 16;
const int  A9_PIN  = 17;
const int  A10_PIN = 18;
const int  A11_PIN = 19;
const int  A12_PIN = 20;
const int  A13_PIN = 21;
const int  A14_PIN = 22;
const int  DDIR_A15_PIN = 26;

const int OE_PIN = 27;
const int CE_PIN = 28;

// Arrays for setting GPIOs up
#define NUM_ADDR 16
#define NUM_DATA 8

#define CE_OE_MASK ((1 << CE_PIN) | (1 << OE_PIN))

const int address_pins[NUM_ADDR] =
  {
   A0_PIN,
   A1_PIN,
   A2_PIN,
   A3_PIN,
   A4_PIN,
   A5_PIN,
   A6_PIN,
   A7_PIN,
   A8_PIN,
   A9_PIN,
   A10_PIN,
   A11_PIN,
   A12_PIN,
   A13_PIN,
   A14_PIN,
   DDIR_A15_PIN,
  };

const int data_pins[NUM_DATA] =
  {
   D0_PIN,
   D1_PIN,
   D2_PIN,
   D3_PIN,
   D4_PIN,
   D5_PIN,
   D6_PIN,
   D7_PIN,
  };

////////////////////////////////////////////////////////////////////////////////

//-----------------------------------------------------------------------------
//
// Put a value on the data bus

inline void set_data(BYTE data)
{
  int states;
  int dat = data & 0xff;
  
  // Direct register access to make things faster
  sio_hw->gpio_set = (  dat  << 0);
  sio_hw->gpio_clr = ((dat ^ 0xFF) << 0);
}



////////////////////////////////////////////////////////////////////////////////
//
// Set things up then sit in a loop waiting for the emulated devcie to
// be selected
//
////////////////////////////////////////////////////////////////////////////////

#define MAX_ADDR_TRACE 1024*64
int trace_on = 0;
volatile int addr_trace_index = 0;
volatile uint16_t addr_trace[MAX_ADDR_TRACE];
volatile unsigned int number_ce_assert = 0;

void rom_emulate(void)
{

  irq_set_mask_enabled( 0xFFFFFFFF, false );

  while(1)
    {
      uint32_t gpio_states;
      BYTE db;
      unsigned int addr;
      unsigned int last_addr;

      // Get off bus
      gpio_put(DDIR_A15_PIN, 1);
      
      // read GPIOs
      gpio_states = sio_hw->gpio_in;
      
      // We look for CE and OE being low
      if( (gpio_states & CE_OE_MASK) != 0 )
      	{
          // CE high, we are not selected

        }
      else
      	{
          // CE and OE low, we are selected
          // Drive bus
          gpio_put(DDIR_A15_PIN, 0);
                
          // ROM emulation so always a read of us
          // get address
          addr = (gpio_states >> 8) & ADDRESS_MASK;
	  
          // Get data and present it on bus
          set_data(rom_data[addr]);

          //          printf("\nA");
          //set_data(0xF8);
	  
#if TRACE_ON
          if( trace_running )
            {
              trace_addr[trace_i] = addr;
              trace_value[trace_i] = rom_data[addr];
              trace_type[trace_i++] = 'R';
              if( trace_i == TRACE_N )
                {
                  trace_running = 0;
                }
            }
#endif

          last_addr = addr;
          
          number_ce_assert++;
#if 1
          // Wait for CE or OE to be de-asserted
          while(1)
            {
              gpio_states = sio_hw->gpio_in;
	      
              // We look for CE and OE to be non zero
              if( (gpio_states & CE_OE_MASK) != 0 )
                {
                  // get off bus quickly
                  gpio_put(DDIR_A15_PIN, 1);
                  
                  //                  printf("\nD");
                  // CE or OE high, we are not selected
#if TRACE_ON
                  if( trace_running && (last_addr != addr)  )
                    {
                      trace_addr[trace_i] = addr;
                      trace_value[trace_i] = rom_data[addr];
                      trace_type[trace_i++] = 'X';
                      if( trace_i == TRACE_N )
                        {
                          trace_running = 0;
                        }
                    }
#endif
                  break;
                }

              // CE and OE low, we are selected
              // ROM emulation so always a read of us
              // get address
              addr = (gpio_states >> 8) & ADDRESS_MASK;
              
              // Get data and present it on bus
              set_data(rom_data[addr]);
              
#if TRACE_ON
              if( trace_running && (last_addr != addr)  )
                {
                  trace_addr[trace_i] = addr;
                  trace_value[trace_i] = rom_data[addr];
                  trace_type[trace_i++] = 'L';
                  if( trace_i == TRACE_N )
                    {
                      trace_running = 0;
                    }
                }
#endif
              last_addr = addr;
            }
#endif
        }
    }
}

////////////////////////////////////////////////////////////////////////////////
//
// trace what the processor is doing

void cli_trace_addresses(void)
{
  trace_i = 0;
  trace_running = 1;
}

void cli_dump_trace(void)
{
  printf("\nTrace\n");
  printf("\nTrace index;%d Trace running:%d\n", trace_i, trace_running);
  
  for(int i = 0; i<TRACE_B; i++)
    {
      printf("\n");
      for(int b = 0; b< TRACE_N/TRACE_B; b++)
        {
          int bi = i+TRACE_B*b;
          printf("%02X: %04X %c %02X   ", bi, trace_addr[bi], trace_type[bi], trace_value[bi]);
        }
    }
  printf("\n");
}


////////////////////////////////////////////////////////////////////////////////

void cli_boot_mass(void)
{
  reset_usb_boot(0,0);
}

void cli_information(void)
{
  printf("\nInformation");
}

////////////////////////////////////////////////////////////////////////////////
//
//
// We allow digits to enter a new value for the parameter

void cli_enter_parameter()
{
  int  key;
  int done = 0;

  printf("\nEnter parameter: (ESC or <RETURN> to exit)");
  
  parameter = 0;
  
  while(!done)
    {
      if( ((key = getchar_timeout_us(1000)) != PICO_ERROR_TIMEOUT))
	{
#if PAR_TYPE_DEC
	  switch(key)
	    {
	    case '0':
	    case '1':
	    case '2':
	    case '3':
	    case '4':
	    case '5':
	    case '6':
	    case '7':
	    case '8':
	    case '9':
	      parameter *= 10;
	      parameter += (key - '0');
	      prompt();
	      break;

	    case 27:
	    case 13:
	    case 10:
	      done = 1;
	      break;
	      
	    default:
	      break;
	    }
#else
	  switch(key)
	    {
	    case '0':
	    case '1':
	    case '2':
	    case '3':
	    case '4':
	    case '5':
	    case '6':
	    case '7':
	    case '8':
	    case '9':
	      parameter *= 16;
	      parameter += (key - '0');
	      prompt();
	      break;
              
	    case 'a':
	    case 'b':
	    case 'c':
	    case 'd':
	    case 'e':
	    case 'f':
	      parameter *= 16;
	      parameter += (key - 'a'+10);
	      prompt();
              break;
              
	    case 27:
	    case 13:
	    case 10:
	      done = 1;
	      break;
	      
	    default:
	      break;
	    }
#endif
	}
      else
	{
	  // I have found that I need to send something if the serial USB times out
	  // otherwise I get lockups on the serial communications.
	  // So, if we get a timeout we send a space and backspace it. And
	  // flush the stdio, but that didn't fix the problem but seems like a good idea.
	  stdio_flush();
	  //printf(" \b");
	}
    }
}

////////////////////////////////////////////////////////////////////////////////

#define BYTE_WIDTH 16

void cli_dump_ram(void)
{
  char ascii[BYTE_WIDTH*3+5];
  char ascii_byte[5];

  // Bound the address to 64K

  parameter %= 64*1024;
  
  // Display memory from address
  printf("\n");

  ascii[0] = '\0';
  
  for(unsigned int z = parameter; z<parameter+512; z++)
    {
      int byte = 0;
      
      if( (z % BYTE_WIDTH) == 0)
	{
	  printf("  %s", ascii);
	  ascii[0] = '\0';
	  printf("\n%08X: ", z);
	}

      byte = rom_data[z];

      printf(" %02X", byte);
      
      if( isprint(byte) )
	{
	  sprintf(ascii_byte, "%c", byte);
	}
      else
	{
	  sprintf(ascii_byte, ".");
	}
      
      strcat(ascii, ascii_byte);
    }
  
  printf("\n");

  parameter += 512;
}

//------------------------------------------------------------------------------

void cli_dump_ram2(void)
{
  for(int a=parameter; a<parameter+256; a++)
    {
      if( (a % 16) == 0 )
        {
          printf("\n%04X: ", a);
        }
      else
        {
          if( (a % 8) == 0 )
            {
              printf(" ");
            }
        }
      
      printf(" %02X", rom_data[a]);
    }

  printf("\n");
  
}
////////////////////////////////////////////////////////////////////////////////

void prompt(void)
{
  printf("\n\n(Text Parameter:'%s'", text_parameter);
#if PAR_TYPE_DEC
  printf("\n(Parameter %d >", parameter);
#else
  printf("\n(Parameter 0x%04X >", parameter);
#endif
}

////////////////////////////////////////////////////////////////////////////////

void cli_digit(void)
{
  printf("\n%d", keypress);
}

////////////////////////////////////////////////////////////////////////////////

// Serial loop command structure

typedef void (*SERIAL_FPTR)(void);

typedef struct
{
  char key;
  char *desc;
  SERIAL_FPTR fn;
} SERIAL_COMMAND;

SERIAL_COMMAND serial_cmds[] =
  {
    {
      '?',
      "Serial command help",
      serial_help,
    },
    {
      '!',
      "Boot to mass storage",
      cli_boot_mass,
    },
    {
      'i',
      "Information",
      cli_information,
    },
    {
      't',
      "Trace",
      cli_trace_addresses,
    },
    {
      'u',
      "Dump trace",
      cli_dump_trace,
    },
    {
      'a',
      "Dump RAM",
      cli_dump_ram,
    },
    {
      'z',
      "Enter parameter value",
      cli_enter_parameter,
    },
    {
      '0',
      "*Digit",
      cli_digit,
    },
    {
      '1',
      "*Digit",
      cli_digit,
    },
    {
      '2',
      "*Digit",
      cli_digit,
    },
    {
      '3',
      "*Digit",
      cli_digit,
    },
    {
      '4',
      "*Digit",
      cli_digit,
    },
    {
      '5',
      "*Digit",
      cli_digit,
    },
    {
      '6',
      "*Digit",
      cli_digit,
    },
    {
      '7',
      "*Digit",
      cli_digit,
    },
    {
      '8',
      "*Digit",
      cli_digit,
    },
    {
      '9',
      "*Digit",
      cli_digit,
    },
  };


////////////////////////////////////////////////////////////////////////////////
//
// Serial CLI Handling
//
////////////////////////////////////////////////////////////////////////////////

int pcount = 0;
int periodic_read = 0;

void serial_loop()
{
  int  key;
  
  if( ((key = getchar_timeout_us(1000)) != PICO_ERROR_TIMEOUT))
    {
      for(int i=0; i<sizeof(serial_cmds)/sizeof(SERIAL_COMMAND);i++)
	{
	  if( serial_cmds[i].key == key )
	    {
#if DEBUG_SERIAL
	      printf("\nKey:%d (0x%02X)", key, key);
#endif
	      keypress = key;
	      (*serial_cmds[i].fn)();
	      prompt();
	      break;
	    }
	}
    }
}

void serial_help(void)
{
  printf("\n");
  
  for(int i=0; i<sizeof(serial_cmds)/sizeof(SERIAL_COMMAND);i++)
    {
      if( *(serial_cmds[i].desc) != '*' )
	{
	  printf("\n%c:   %s", serial_cmds[i].key, serial_cmds[i].desc);
	}
    }
  printf("\n0-9: Enter parameter digit");
}


int main()
{

  ////////////////////////////////////////////////////////////////////////////////
  //
  // Overclock as needed
  //
  ////////////////////////////////////////////////////////////////////////////////
  
  //#define OVERCLOCK 135000
  //#define OVERCLOCK 200000
#define OVERCLOCK 270000
  //#define OVERCLOCK 360000
  
#if OVERCLOCK > 270000
  /* Above this speed needs increased voltage */
  vreg_set_voltage(VREG_VOLTAGE_1_20);
  sleep_ms(1000);
#endif
  
  /* Overclock */
  set_sys_clock_khz( OVERCLOCK, 1 );

  //DEBUG_STOP;
  
  char line[80];

  stdio_init_all();

  printf("\nPico ROM Emulator\n");
  
#if TEST_STDIO
  {
  int count;
  while (true)
    {
      count++;
      
      if( (count % 1000000) == 0 )
	{
	  sprintf(line, "\nRP2040: %d", count);
	  printf(line);
	}
    }
  }
#endif

  printf("\nSetting GPIOs...");

  for (int i=0; i<NUM_ADDR; i++)
    {
      // Set up directions for the control lines
      gpio_init(address_pins[i]);
      gpio_set_dir(address_pins[i], GPIO_IN);
    }

  for (int i=0; i<NUM_DATA; i++)
    {
      // Set up directions for the control lines
      gpio_init(data_pins[i]);
      gpio_set_dir(data_pins[i], GPIO_OUT);
    }

  gpio_init(OE_PIN);
  gpio_set_dir(OE_PIN, GPIO_IN);
  gpio_init(CE_PIN);
  gpio_set_dir(CE_PIN, GPIO_IN);

  // DEBUG: Use DDIR_A15 as status line
  gpio_init(DDIR_A15_PIN);
  gpio_set_dir(DDIR_A15_PIN, GPIO_OUT);

  int ce = 0;

#if 0
  while(1)
    {
      ce = gpio_get(CE_PIN);
      gpio_put(DDIR_A15_PIN, ce);
    }
#endif

#if 0
  while(1)
    {
      uint32_t gpio_states;
      gpio_states = sio_hw->gpio_in;
      if( gpio_states & (1 << CE_PIN))
	{
	  gpio_put(DDIR_A15_PIN, 1);
	}
      else
	{
	  gpio_put(DDIR_A15_PIN, 0);
	}
    }
#endif

#if 0
  gpio_init(DDIR_A15_PIN);
  gpio_set_dir(DDIR_A15_PIN, GPIO_OUT);

  while(1)
    {
      printf("\nONE");
      gpio_put(DDIR_A15_PIN, 1);
      printf("\nZero");
      gpio_put(DDIR_A15_PIN, 0);
    }
#endif

  
  //set_data_outputs();
#if 0
#if !USE_OE_FOR_DATA_DIRECTION


  // LS_DIR is an output
  gpio_set_dir(LS_DIR_PIN, GPIO_OUT);
#else
  gpio_put(DDIR_A15_PIN, 0);
  gpio_set_dir(DDIR_A15_PIN, GPIO_OUT);
#endif
#endif
  

  // Use a polling loop for minimum latency
#if 0
  // Turn off timer interrupts
  irq_set_mask_enabled(0xf, false);
#endif
  
  // We set the CE of the level shifters to be driven by OE on the
  // host board, and the direction (A->B) to be set up by the Pico
  // The data direction can be left as output from the Pico as
  // the OE/CE line will drive on to the data bus when OE is asserted


#if 0
  while(1)
    {
      set_data(0xf8);
    }
#endif

#if EMULATE_ON_CORE1
  multicore_launch_core1(rom_emulate);

  printf("\n");
  printf("\n                                  ********************************************");
  printf("\n                                  *             Pico RPM Emulator             *");
  printf("\n                                  ********************************************");
  printf("\n");
  printf("\n");

  int count = 0;
  
  while(1)
  {
    count++;

    if( (count % 10000) == 0 )
      {
        //        printf("\n%d", count);
      }
    serial_loop();
  }


#else
  rom_emulate();
#endif
  
      //      gpio_put(DDIR_A15_PIN, 0);

}
